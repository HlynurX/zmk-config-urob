#define CONFIG_WIRELESS

/* TOTEM: 38 keys = urob's 34-key base + 4 extras (marked with *).
 *
 *         ╭─────┬─────┬─────┬─────┬─────╮   ╭─────┬─────┬─────┬─────┬─────╮
 *         │ LT4 │ LT3 │ LT2 │ LT1 │ LT0 │   │ RT0 │ RT1 │ RT2 │ RT3 │ RT4 │
 *         ├─────┼─────┼─────┼─────┼─────┤   ├─────┼─────┼─────┼─────┼─────┤
 *         │ LM4 │ LM3 │ LM2 │ LM1 │ LM0 │   │ RM0 │ RM1 │ RM2 │ RM3 │ RM4 │
 *   ╭─────┼─────┼─────┼─────┼─────┼─────┤   ├─────┼─────┼─────┼─────┼─────┼─────╮
 *   │ OL* │ LB4 │ LB3 │ LB2 │ LB1 │ LB0 │   │ RB0 │ RB1 │ RB2 │ RB3 │ RB4 │ OR* │
 *   ╰─────┴─────┴─────┼─────┼─────┼─────┤   ├─────┼─────┼─────┼─────┴─────┴─────╯
 *                     │ TL* │ LH1 │ LH0 │   │ RH0 │ RH1 │ TR* │
 *                     ╰─────┴─────┴─────╯   ╰─────┴─────┴─────╯
 *
 * Three thumbs per side: LH1/LH0 and RH0/RH1 come from base.keymap (the LH and
 * RH blocks), TL/TR are the Totem's outer thumbs. The extras are set per layer
 * in the table below as (OL outer-left pinky, OR outer-right pinky,
 * TL left outer thumb, TR right outer thumb).
 *
 * Gaming mode: hold space (Nav) + OR toggles it on; in Game, hold TR (Nav) + OR
 * toggles it off again.
 */
#define TOTEM_EXTRAS_Base  (&kp LSHFT, &kp SQT,   &kp LGUI,             &smart_mouse)
#define TOTEM_EXTRAS_Game  (&kp LSHFT, &kp SQT,   &game_ctl LCTRL ESC,  &lt NAV DEL)
#define TOTEM_EXTRAS_Nav   (___,       &tog GAME, ___,                  ___)
#define TOTEM_EXTRAS_Fn    (___,       ___,       ___,                  ___)
#define TOTEM_EXTRAS_Num   (___,       ___,       ___,                  ___)
#define TOTEM_EXTRAS_Sys   (___,       ___,       ___,                  ___)
#define TOTEM_EXTRAS_Mouse (___,       ___,       ___,                  ___)

#define _TOTEM_OL(ol, or, tl, tr) ol
#define _TOTEM_OR(ol, or, tl, tr) or
#define _TOTEM_TL(ol, or, tl, tr) tl
#define _TOTEM_TR(ol, or, tl, tr) tr
#define TOTEM_OL(extras) _TOTEM_OL extras
#define TOTEM_OR(extras) _TOTEM_OR extras
#define TOTEM_TL(extras) _TOTEM_TL extras
#define TOTEM_TR(extras) _TOTEM_TR extras

#define ZMK_BASE_LAYER(name, LT, RT, LM, RM, LB, RB, LH, RH)                   \
    ZMK_LAYER(                                                                 \
        name,                                                                  \
                                         LT RT                                 \
                                         LM RM                                 \
        TOTEM_OL(TOTEM_EXTRAS_##name)    LB RB    TOTEM_OR(TOTEM_EXTRAS_##name)\
        TOTEM_TL(TOTEM_EXTRAS_##name)    LH RH    TOTEM_TR(TOTEM_EXTRAS_##name)\
    )

#include "zmk-helpers/key-labels/totem.h"
#include "base.keymap"

// Gaming ctrl/esc thumb: plain tap-preferred, i.e. ctrl only after holding
// 200ms and never decided early by other keys (same as the old totem config).
ZMK_HOLD_TAP(game_ctl, bindings = <&kp>, <&kp>; flavor = "tap-preferred";
             tapping-term-ms = <200>;)
